## Kconfig.projbuild
```kconfig
menu "GROCY TERMINAL"

    config GROCY_API_URL
        string "Grocy API Base URL"
        default "http://grocy.local"
        help
            Base URL of your Grocy instance, e.g. http://grocy.local or https://grocy.example.com.

    config GROCY_API_KEY
        string "Grocy API Key"
        default ""
        help
            Grocy API key. For production, leave blank and set via the on-device setup screen (stored in NVS).

    config GROCY_LOCATION_ID
        int "Grocy Location ID"
        default 1
        help
            Grocy location ID to filter displayed products. Overridden by NVS value set in setup screen.

    config GROCY_REFRESH_INTERVAL_SEC
        int "Product list refresh interval (seconds)"
        default 300
        range 10 3600
        help
            How often to re-fetch the product list from Grocy.

    config GROCY_OTA_MANIFEST_URL
        string "OTA Manifest URL"
        default ""
        help
            HTTPS URL to a JSON manifest file: {"version":"1.0.0","firmware_url":"https://..."}.
            Leave blank to disable OTA.

    config GROCY_OTA_CHECK_INTERVAL_SEC
        int "OTA check interval (seconds)"
        default 3600
        range 60 86400

    config GROCY_SCREEN_WAKE_CAMERA
        bool "Enable camera-based presence detection for screen wake"
        default n
        help
            When enabled, the onboard camera detects motion/presence and wakes the screen.
            Costs ~20-30 mA extra. Default: use MQTT trigger from Home Assistant.

    config GROCY_MQTT_BROKER_URL
        string "MQTT Broker URL"
        default "mqtt://homeassistant.local"
        help
            MQTT broker URL. Use mqtts:// for TLS (port 8883). Example: mqtt://192.168.1.10:1883

    config GROCY_MQTT_PORT
        int "MQTT Port (0 = use scheme default)"
        default 0
        range 0 65535

    config GROCY_MQTT_USERNAME
        string "MQTT Username"
        default ""

    config GROCY_MQTT_PASSWORD
        string "MQTT Password"
        default ""

    config GROCY_DEVICE_ID
        string "Device ID (overrides eFuse MAC)"
        default ""
        help
            Override the device ID used in MQTT topics. If blank, the 12-char hex eFuse MAC is used.

    config GROCY_MQTT_LOG_LEVEL
        int "MQTT log level (0=none 1=error 2=warn 3=info 4=debug)"
        default 2
        range 0 4

    config GROCY_WIFI_SSID
        string "WiFi SSID (initial flash default)"
        default ""
        help
            Default WiFi SSID. Overridden by NVS value set in setup screen.

    config GROCY_WIFI_PASSWORD
        string "WiFi Password (initial flash default)"
        default ""

    config GROCY_IMAGE_CACHE_SIZE
        int "Image cache size (number of images)"
        default 200
        range 10 500

endmenu
```

## main/Kconfig.projbuild
```kconfig
menu "GROCY TERMINAL"

    config GROCY_PROVISIONED_BY_KCONFIG
        bool "Skip setup screen — use Kconfig values as provisioned config"
        default n
        help
            When NVS is empty, treat the Kconfig values (WiFi SSID, Grocy URL, etc.)
            as the provisioned configuration and skip the first-boot setup screen.
            Enable this for development to avoid the touchscreen setup flow.

    config GROCY_MIPI_DSI_PHY_LDO_CHAN
        int "MIPI DSI PHY LDO channel (0 to disable)"
        default 3
        range 0 4
        help
            Internal LDO channel that supplies 2.5 V to VDD_MIPI_DPHY.
            On the ESP32-P4-Function-EV-Board and JC1060P470C this is channel 3.
            Set to 0 to skip LDO enable (if powered externally).

    config GROCY_BACKLIGHT_GPIO
        int "Backlight GPIO pin (-1 = always on / not GPIO-controlled)"
        default 26
        range -1 54
        help
            GPIO used for backlight PWM via LEDC. Set to -1 if the backlight
            is always on or controlled outside the firmware (some modules).

    config GROCY_API_URL
        string "Grocy API Base URL"
        default "http://grocy.local"
        help
            Base URL of your Grocy instance, e.g. http://grocy.local or https://grocy.example.com.

    config GROCY_API_KEY
        string "Grocy API Key"
        default ""
        help
            Grocy API key. For production, leave blank and set via the on-device setup screen (stored in NVS).

    config GROCY_LOCATION_ID
        int "Grocy Location ID"
        default 1
        help
            Grocy location ID to filter displayed products. Overridden by NVS value set in setup screen.

    config GROCY_REFRESH_INTERVAL_SEC
        int "Product list refresh interval (seconds)"
        default 300
        range 10 3600
        help
            How often to re-fetch the product list from Grocy.

    config GROCY_OTA_MANIFEST_URL
        string "OTA Manifest URL"
        default ""
        help
            HTTPS URL to a JSON manifest file: {"version":"1.0.0","firmware_url":"https://..."}.
            Leave blank to disable OTA.

    config GROCY_OTA_CHECK_INTERVAL_SEC
        int "OTA check interval (seconds)"
        default 3600
        range 60 86400

    config GROCY_SCREEN_WAKE_CAMERA
        bool "Enable camera-based presence detection for screen wake"
        default n
        help
            When enabled, the onboard camera detects motion/presence and wakes the screen.
            Costs ~20-30 mA extra. Default: use MQTT trigger from Home Assistant.

    config GROCY_MQTT_BROKER_URL
        string "MQTT Broker URL"
        default "mqtt://homeassistant.local"
        help
            MQTT broker URL. Use mqtts:// for TLS (port 8883). Example: mqtt://192.168.1.10:1883

    config GROCY_MQTT_PORT
        int "MQTT Port (0 = use scheme default)"
        default 0
        range 0 65535

    config GROCY_MQTT_USERNAME
        string "MQTT Username"
        default ""

    config GROCY_MQTT_PASSWORD
        string "MQTT Password"
        default ""

    config GROCY_DEVICE_ID
        string "Device ID (overrides eFuse MAC)"
        default ""
        help
            Override the device ID used in MQTT topics. If blank, the 12-char hex eFuse MAC is used.

    config GROCY_MQTT_LOG_LEVEL
        int "MQTT log level (0=none 1=error 2=warn 3=info 4=debug)"
        default 2
        range 0 4

    config GROCY_WIFI_SSID
        string "WiFi SSID (initial flash default)"
        default ""
        help
            Default WiFi SSID. Overridden by NVS value set in setup screen.

    config GROCY_WIFI_PASSWORD
        string "WiFi Password (initial flash default)"
        default ""

    config GROCY_IMAGE_CACHE_SIZE
        int "Image cache size (number of images)"
        default 200
        range 10 500

endmenu
```

## sdkconfig.defaults
```kconfig
# Target
CONFIG_IDF_TARGET="esp32p4"

# Flash size — JC1060P470C has 8 MB flash
CONFIG_ESPTOOLPY_FLASHSIZE_8MB=y
CONFIG_ESPTOOLPY_FLASHSIZE="8MB"

# Partition table
CONFIG_PARTITION_TABLE_CUSTOM=y
CONFIG_PARTITION_TABLE_CUSTOM_FILENAME="partitions.csv"

# OTA rollback
CONFIG_BOOTLOADER_APP_ROLLBACK_ENABLE=y

# PSRAM — 200 MHz requires IDF_EXPERIMENTAL_FEATURES
CONFIG_SPIRAM=y
CONFIG_SPIRAM_USE_MALLOC=y
CONFIG_SPIRAM_ALLOW_BSS_SEG_EXTERNAL_MEMORY=y
CONFIG_SPIRAM_MALLOC_ALWAYSINTERNAL=8192
CONFIG_IDF_EXPERIMENTAL_FEATURES=y
CONFIG_SPIRAM_SPEED_200M=y

# LVGL PNG and MemFS support (MemFS drive letter 'M' = 77)
CONFIG_LV_USE_PNG=y
CONFIG_LV_USE_FS_MEMFS=y
CONFIG_LV_FS_MEMFS_LETTER=77

# LVGL rendering performance
# PPA (Pixel Processing Accelerator) — hardware fills/blending on ESP32-P4
CONFIG_LV_USE_PPA=y
CONFIG_LV_USE_PPA_IMG=y
# Cache-line alignment required for PPA DMA
CONFIG_LV_DRAW_BUF_ALIGN=64
# 60 fps render cadence (was 33 ms / ~30 fps)
CONFIG_LV_DEF_REFR_PERIOD=16

# FreeRTOS
CONFIG_FREERTOS_HZ=1000
CONFIG_FREERTOS_UNICORE=n

# Log
CONFIG_LOG_DEFAULT_LEVEL_INFO=y
CONFIG_LOG_MAXIMUM_LEVEL_VERBOSE=y

# WiFi via ESP32-C6 co-processor using esp_wifi_remote + esp_hosted (SDIO)
# JC1060P470C SDIO pins: CLK=18 CMD=19 D0=14 D1=15 D2=16 D3=17 RST=54

# HTTP client
CONFIG_ESP_HTTP_CLIENT_ENABLE_HTTPS=y

# SNTP
CONFIG_LWIP_SNTP_MAX_SERVERS=2

# Stack sizes
CONFIG_ESP_MAIN_TASK_STACK_SIZE=8192
CONFIG_ESP_SYSTEM_EVENT_TASK_STACK_SIZE=6144

# Task watchdog
CONFIG_ESP_TASK_WDT_TIMEOUT_S=30

# Board hardware config
CONFIG_GROCY_BACKLIGHT_GPIO=23
CONFIG_GROCY_MIPI_DSI_PHY_LDO_CHAN=3
CONFIG_GROCY_PROVISIONED_BY_KCONFIG=n
```

## test_app/main/Kconfig.projbuild
```kconfig
menu "GROCY TERMINAL"

    config GROCY_API_URL
        string "Grocy API Base URL"
        default "http://grocy.local"

    config GROCY_API_KEY
        string "Grocy API Key"
        default ""

    config GROCY_LOCATION_ID
        int "Grocy Location ID"
        default 1

    config GROCY_REFRESH_INTERVAL_SEC
        int "Product list refresh interval (seconds)"
        default 300
        range 10 3600

    config GROCY_OTA_MANIFEST_URL
        string "OTA Manifest URL"
        default ""

    config GROCY_OTA_CHECK_INTERVAL_SEC
        int "OTA check interval (seconds)"
        default 3600
        range 60 86400

    config GROCY_SCREEN_WAKE_CAMERA
        bool "Enable camera-based presence detection"
        default n

    config GROCY_MQTT_BROKER_URL
        string "MQTT Broker URL"
        default "mqtt://homeassistant.local"

    config GROCY_MQTT_PORT
        int "MQTT Port"
        default 0
        range 0 65535

    config GROCY_MQTT_USERNAME
        string "MQTT Username"
        default ""

    config GROCY_MQTT_PASSWORD
        string "MQTT Password"
        default ""

    config GROCY_DEVICE_ID
        string "Device ID"
        default ""

    config GROCY_MQTT_LOG_LEVEL
        int "MQTT log level"
        default 2
        range 0 4

    config GROCY_WIFI_SSID
        string "WiFi SSID"
        default ""

    config GROCY_WIFI_PASSWORD
        string "WiFi Password"
        default ""

    config GROCY_IMAGE_CACHE_SIZE
        int "Image cache size"
        default 200
        range 10 500

endmenu
```

## test_app/sdkconfig.defaults
```kconfig
# Linux host target — set via: idf.py --preview set-target linux

# These values satisfy CONFIG_ references in config.c when NVS has no stored value.
CONFIG_GROCY_WIFI_SSID=""
CONFIG_GROCY_WIFI_PASSWORD=""
CONFIG_GROCY_API_URL="http://grocy.local"
CONFIG_GROCY_API_KEY=""
CONFIG_GROCY_LOCATION_ID=1
CONFIG_GROCY_MQTT_BROKER_URL="mqtt://homeassistant.local"
CONFIG_GROCY_MQTT_USERNAME=""
CONFIG_GROCY_MQTT_PASSWORD=""
CONFIG_GROCY_MQTT_LOG_LEVEL=2
CONFIG_GROCY_DEVICE_ID=""
CONFIG_GROCY_IMAGE_CACHE_SIZE=200
CONFIG_GROCY_REFRESH_INTERVAL_SEC=300
CONFIG_GROCY_OTA_MANIFEST_URL=""
CONFIG_GROCY_OTA_CHECK_INTERVAL_SEC=3600
CONFIG_GROCY_SCREEN_WAKE_CAMERA=n
CONFIG_GROCY_MQTT_PORT=0
```
